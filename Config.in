## Config.in
```kconfig
# SPDX-License-Identifier: GPL-2.0

config VELRISC1_DRIVER_TRACE
	bool "Build driver for tracing"
	depends on PACKAGE_kmod-elvees-risc1
	help
	  The elrisc driver should be compiled with -fno-inline
	  for accessibility of all driver functions via ftrace.
```
